## config/boards/shields/caldera/Kconfig.defconfig
```kconfig
if SHIELD_CALDERA_DONGLE

config ZMK_KEYBOARD_NAME
    default "Caldera"

config ZMK_SPLIT_ROLE_CENTRAL
    default y

endif

if ZMK_DISPLAY

config I2C
    default y

config SSD1306
    default y

choice ZMK_DISPLAY_WORK_QUEUE
    default ZMK_DISPLAY_WORK_QUEUE_DEDICATED
endchoice

endif

if SHIELD_CALDERA_DONGLE || SHIELD_CALDERA_LEFT || SHIELD_CALDERA_RIGHT

config ZMK_SPLIT
    default y

endif
```

## config/boards/shields/caldera/Kconfig.shield
```kconfig
config SHIELD_CALDERA_DONGLE
    def_bool $(shields_list_contains,caldera_dongle)

config SHIELD_CALDERA_LEFT
    def_bool $(shields_list_contains,caldera_left)

config SHIELD_CALDERA_RIGHT
    def_bool $(shields_list_contains,caldera_right)
```
